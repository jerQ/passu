## main/Kconfig.projbuild
```kconfig
menu "passu"

    config DW_BUTTON_GPIO
        int "Trigger button GPIO"
        default 9 if IDF_TARGET_ESP32C3
        default 0
        range 0 48
        help
            GPIO of a push button wired to GND (internal pull-up is enabled).
            The BOOT button is GPIO0 on most ESP32 and ESP32-S3 boards and
            GPIO9 on ESP32-C3 boards.

    config DW_GROUPS
        int "Number of word+digit groups"
        default 8
        range 5 16
        help
            Each group is one EFF word (five d6 rolls) plus one digit 0-9,
            about 16.25 bits per group. 8 groups is about 130 bits; the
            minimum of 5 is about 81 bits.

    config DW_SERIAL_TRIGGER
        bool "Also generate on Enter in the serial console"
        default y

    config DW_WORDLIST_SHA256
        string "Expected SHA-256 of eff_large_wordlist.txt (hex)"
        default "addd35536511597a02fa0a9ff1e5284677b8883b83e986e43f15a3db996b903e"
        help
            The build fails, and boot halts, unless the embedded wordlist
            matches this hash. The default is the published hash of the EFF
            large wordlist. Leave empty to skip both checks (not recommended).

    config DW_LOCKDOWN_ACK
        bool "I understand that Secure Boot eFuse changes are PERMANENT"
        depends on SECURE_BOOT
        default n
        help
            Secure Boot is enabled, so the first boot of this firmware burns
            eFuses that can never be reset:

            - BLOCK2 key digest: only firmware signed with this one key will
              ever run. Losing the key means no more updates, ever.
            - ABS_DONE_1: Secure Boot is on for good.
            - JTAG_DISABLE: no JTAG debugging, ever.
            - CONSOLE_DEBUG_DISABLE: no ROM BASIC console.
            - WR_DIS_EFUSE_RD_DISABLE: no eFuse can be read-protected
              later, so flash encryption can't be added.
            - UART_DOWNLOAD_DIS (if download mode is set to "Permanently
              disabled"): esptool and espefuse can never connect again, so
              the board can't be reflashed or recovered over USB.

            A mistake can leave the board unusable. Read "Locking down a
            device" in SECURITY.md and try a spare board first. The build
            refuses to run until this is set.

endmenu
```
